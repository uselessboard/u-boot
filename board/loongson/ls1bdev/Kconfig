## board/loongson/ls1bdev/Kconfig
```kconfig
if BOARD_LS1BDEV

config SYS_BOARD
	default "ls1bdev"

config SYS_VENDOR
	default "loongson"

config SYS_CONFIG_NAME
	default "ls1b200"

endif
```

## board/mediatek/mt7620/Kconfig
```kconfig
if BOARD_MT7620_RFB

config SYS_BOARD
	default "mt7620"

config SYS_VENDOR
	default "mediatek"

config SYS_CONFIG_NAME
	default "mt7620"

endif
```

## drivers/pinctrl/lsmips/Kconfig
```kconfig
config PINCTRL_LSMIPS
	depends on ARCH_LSMIPS
	bool

config PINCTRL_LS1B200
	bool "Loongson LS1B200 pin control driver"
	select PINCTRL_LSMIPS
	depends on SOC_LS1B200 && PINCTRL_GENERIC
	help
	  Support pin multiplexing control on MediaTek LS7628.
	  The driver is controlled by a device tree node which contains
	  the pin mux functions for each available pin groups.
```
